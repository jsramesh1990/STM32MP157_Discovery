## STM32MP157_Discovery/yocto/meta-energy-sensor/conf/layer.conf
```bitbake
# STM32MP157 Energy Sensor Yocto Layer
# Copyright (C) 2026

BBPATH .= ":${LAYERDIR}"

BBFILES += "${LAYERDIR}/recipes-*/*/*.bb"
BBFILES += "${LAYERDIR}/recipes-*/*/*.bbappend"

BBFILE_COLLECTIONS += "energy-sensor"

BBFILE_PATTERN_energy-sensor = "^${LAYERDIR}/"

BBFILE_PRIORITY_energy-sensor = "8"

LAYERSERIES_COMPAT_energy-sensor = "kirkstone"

LAYERDEPENDS_energy-sensor = "core"
```
